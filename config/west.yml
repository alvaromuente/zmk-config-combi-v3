## config/west.yml
```yaml
manifest:
  remotes:
    - name: zmkfirmware
      url-base: https://github.com/zmkfirmware
    - name: alvaromuente
      url-base: https://github.com/alvaromuente
  projects:
    - name: zmk
      remote: alvaromuente
      revision: combi-v3
      import: app/west.yml
  self:
    path: config
```
